## conf/layer.conf
```bitbake
# We have a conf and classes directory, add to BBPATH
BBPATH .= ":${LAYERDIR}"

# We have recipes-* directories, add to BBFILES
BBFILES += "${LAYERDIR}/recipes-*/*/*.bb \
            ${LAYERDIR}/recipes-*/*/*.bbappend"

# add recipes for subprojects
BBFILES += "${@' '.join('${LAYERDIR}/%s/recipes*/*/*.bb' % layer \
	for layer in BBFILE_COLLECTIONS.split())}"
             
BBFILES += "${@' '.join('${LAYERDIR}/%s/recipes*/*/*.bbappend' % layer \
	for layer in BBFILE_COLLECTIONS.split())}"

BBFILE_COLLECTIONS += "meta-tedge"
BBFILE_PATTERN_meta-tedge = "^${LAYERDIR}/"
BBFILE_PRIORITY_meta-tedge = "6"

LAYERDEPENDS_meta-tedge = "core networking-layer rust-layer"

LAYERSERIES_COMPAT_meta-tedge = "kirkstone honister"

RUSTVERSION ?= "1.75.0"
```

## meta-slb9670-rpi/conf/layer.conf
```bitbake
# We have a conf and classes directory, add to BBPATH
BBPATH .= ":${LAYERDIR}"

# We have recipes-* directories, add to BBFILES
BBFILES += "${LAYERDIR}/recipes-*/*/*.bb \
            ${LAYERDIR}/recipes-*/*/*.bbappend"

BBFILE_COLLECTIONS += "meta-slb9670-rpi"
BBFILE_PATTERN_meta-slb9670-rpi = "^${LAYERDIR}/"
BBFILE_PRIORITY_meta-slb9670-rpi = "6"

LAYERDEPENDS_meta-slb9670-rpi = "core tpm-layer raspberrypi"
LAYERSERIES_COMPAT_meta-slb9670-rpi = "scarthgap"
```

## meta-tedge-bin/conf/layer.conf
```bitbake
# We have a conf and classes directory, add to BBPATH
BBPATH .= ":${LAYERDIR}"

# We have recipes-* directories, add to BBFILES
BBFILES += "${LAYERDIR}/recipes-*/*/*.bb \
            ${LAYERDIR}/recipes-*/*/*.bbappend"

BBFILE_COLLECTIONS += "meta-tedge-bin"
BBFILE_PATTERN_meta-tedge-bin = "^${LAYERDIR}/"
BBFILE_PRIORITY_meta-tedge-bin = "6"

LICENSE_PATH += "${LAYERDIR}/"

LAYERDEPENDS_meta-tedge-bin = "core networking-layer"

LAYERSERIES_COMPAT_meta-tedge-bin = "scarthgap"
```

## meta-tedge-common/conf/bblayers.conf.sample
```bitbake
# POKY_BBLAYERS_CONF_VERSION is increased each time build/conf/bblayers.conf
# changes incompatibly
POKY_BBLAYERS_CONF_VERSION = "2"

BBPATH = "${TOPDIR}"
BBFILES ?= ""

BBLAYERS ?= " \
  /dir/to/layers/poky/meta \
  /dir/to/layers/poky/meta-poky \
  /dir/to/layers/poky/meta-yocto-bsp \
  /dir/to/layers/meta-openembedded/meta-oe \
  /dir/to/layers/meta-openembedded/meta-python \
  /dir/to/layers/meta-openembedded/meta-networking \
  /dir/to/layers/meta-openembedded/meta-multimedia \
  /dir/to/layers/meta-rust \
  /dir/to/layers/meta-raspberrypi \
  /dir/to/layers/meta-tedge \
  /dir/to/layers/meta-mender/meta-mender-core \
  /dir/to/layers/meta-mender/meta-mender-raspberrypi \
  "
```

## meta-tedge-common/conf/layer.conf
```bitbake
# We have a conf and classes directory, add to BBPATH
BBPATH .= ":${LAYERDIR}"

# We have recipes-* directories, add to BBFILES
BBFILES += "${LAYERDIR}/recipes-*/*/*.bb \
            ${LAYERDIR}/recipes-*/*/*.bbappend"

BBFILE_COLLECTIONS += "meta-tedge-common"
BBFILE_PATTERN_meta-tedge-common = "^${LAYERDIR}/"
BBFILE_PRIORITY_meta-tedge-common = "6"

LAYERDEPENDS_meta-tedge-common = "core networking-layer"

LAYERSERIES_COMPAT_meta-tedge-common = "scarthgap"
```

## meta-tedge-core/conf/layer.conf
```bitbake
# We have a conf and classes directory, add to BBPATH
BBPATH .= ":${LAYERDIR}"

# We have recipes-* directories, add to BBFILES
BBFILES += "${LAYERDIR}/recipes-*/*/*.bb \
            ${LAYERDIR}/recipes-*/*/*.bbappend"

# add recipes for subprojects
BBFILES += "${@' '.join('${LAYERDIR}/%s/recipes*/*/*.bb' % layer \
	for layer in BBFILE_COLLECTIONS.split())}"
             
BBFILES += "${@' '.join('${LAYERDIR}/%s/recipes*/*/*.bbappend' % layer \
	for layer in BBFILE_COLLECTIONS.split())}"

BBFILE_COLLECTIONS += "meta-tedge-core"
BBFILE_PATTERN_meta-tedge-core = "^${LAYERDIR}/"
BBFILE_PRIORITY_meta-tedge-core = "6"

LAYERDEPENDS_meta-tedge-core = "core networking-layer"

LAYERSERIES_COMPAT_meta-tedge-core = "kirkstone"
```

## meta-tedge-mender/conf/layer.conf
```bitbake
# We have a conf and classes directory, add to BBPATH
BBPATH .= ":${LAYERDIR}"

# We have recipes-* directories, add to BBFILES
BBFILES += "${LAYERDIR}/recipes-*/*/*.bb \
            ${LAYERDIR}/recipes-*/*/*.bbappend"

BBFILE_COLLECTIONS += "meta-tedge-mender"
BBFILE_PATTERN_meta-tedge-mender = "^${LAYERDIR}/"
BBFILE_PRIORITY_meta-tedge-mender = "6"
LAYERDEPENDS_meta-tedge-mender = "meta-tedge-common"

LICENSE_PATH += "${LAYERDIR}/"

LAYERSERIES_COMPAT_meta-tedge-mender = "scarthgap"
```

## meta-tedge-rauc/conf/layer.conf
```bitbake
# We have a conf and classes directory, add to BBPATH
BBPATH .= ":${LAYERDIR}"

# We have recipes-* directories, add to BBFILES
BBFILES += "${LAYERDIR}/recipes-*/*/*.bb \
            ${LAYERDIR}/recipes-*/*/*.bbappend"

BBFILE_COLLECTIONS += "meta-tedge-rauc"
BBFILE_PATTERN_meta-tedge-rauc = "^${LAYERDIR}/"
BBFILE_PRIORITY_meta-tedge-rauc = "6"
LAYERDEPENDS_meta-tedge-rauc = "meta-tedge-common"

LICENSE_PATH += "${LAYERDIR}/"

LAYERSERIES_COMPAT_meta-tedge-rauc = "scarthgap"
```

## meta-tedge/conf/layer.conf
```bitbake
# We have a conf and classes directory, add to BBPATH
BBPATH .= ":${LAYERDIR}"

# We have recipes-* directories, add to BBFILES
BBFILES += "${LAYERDIR}/recipes-*/*/*.bb \
            ${LAYERDIR}/recipes-*/*/*.bbappend"

BBFILE_COLLECTIONS += "meta-tedge"
BBFILE_PATTERN_meta-tedge = "^${LAYERDIR}/"
BBFILE_PRIORITY_meta-tedge = "6"

LAYERDEPENDS_meta-tedge = "core networking-layer"

LAYERSERIES_COMPAT_meta-tedge = "scarthgap"
```
